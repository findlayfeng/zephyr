## boards/embedfire/tiaozhanzhe/Kconfig.embedfire_tiaozhanzhe
```kconfig
# Copyright (c) 2024 FindlayFeng
# SPDX-License-Identifier: Apache-2.0

config BOARD_EMBEDFIRE_TIAOZHANZHE
	select SOC_STM32F429XX
```

## boards/embedfire/tiaozhanzhe/board.yml
```yaml
board:
  name: embedfire_tiaozhanzhe
  vendor: embedfire
  revision:
    format: custom
    default: "v1_core"
    revisions:
      - name: "v1_core"
  socs:
    - name: stm32f429xx
```

## samples/subsys/usb/mass/boards/embedfire_tiaozhanzhe.conf
```kconfig
CONFIG_DISK_ACCESS=y
CONFIG_DISK_DRIVERS=y
CONFIG_DISK_DRIVER_FLASH=y
CONFIG_SPI_NOR_FLASH_LAYOUT_PAGE_SIZE=4096
```
