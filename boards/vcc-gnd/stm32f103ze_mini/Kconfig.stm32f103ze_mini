## boards/vcc-gnd/stm32f103ze_mini/Kconfig.stm32f103ze_mini
```kconfig
# Copyright (c) 2024 FindlayFeng
# SPDX-License-Identifier: Apache-2.0

config BOARD_STM32F103ZE_MINI
	select SOC_STM32F103XE
```

## boards/vcc-gnd/stm32f103ze_mini/board.yml
```yaml
board:
  name: stm32f103ze_mini
  vendor: vcc-gnd
  socs:
    - name: stm32f103xe
```

## boards/vcc-gnd/stm32f103ze_mini/stm32f103ze_mini_defconfig
```kconfig
# Copyright (c) 2024 FindlayFeng
# SPDX-License-Identifier: Apache-2.0

# enable segger rtt
CONFIG_USE_SEGGER_RTT=y

# enable console
CONFIG_CONSOLE=y
CONFIG_RTT_CONSOLE=y

CONFIG_SHELL=y
CONFIG_SHELL_BACKEND_SERIAL=n
CONFIG_SHELL_BACKEND_RTT=y
CONFIG_SHELL_BACKEND_RTT_RETRY_DELAY_MS=10

CONFIG_GPIO=y

# enable clocks
CONFIG_CLOCK_CONTROL=y

# enable pin controller
CONFIG_PINCTRL=y
```
